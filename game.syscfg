/**
 * @cliArgs --device "MSPM0C110X" --part "Default" --package "SOT-8(DDF)" --product "mspm0_sdk@2.11.00.07"
 * @versions {"tool":"1.26.2+4477"}
 */

/**
 * Import the modules used in this configuration.
 */
const Board  = scripting.addModule("/ti/driverlib/Board");
const I2C    = scripting.addModule("/ti/driverlib/I2C", {}, false);
const I2C1   = I2C.addInstance();
const SYSCTL = scripting.addModule("/ti/driverlib/SYSCTL");

/**
 * Write custom configuration values to the imported modules.
 */

I2C1.$name                           = "I2C_0";
I2C1.basicEnableController           = true;
I2C1.basicControllerStandardBusSpeed = "Fast";
I2C1.sdaPinConfig.$name              = "ti_driverlib_gpio_GPIOPinGeneric0";
I2C1.sclPinConfig.$name              = "ti_driverlib_gpio_GPIOPinGeneric1";

SYSCTL.disableNRSTPin = true;

const ProjectConfig              = scripting.addModule("/ti/project_config/ProjectConfig", {}, false);
ProjectConfig.migrationCondition = true;

/**
 * Pinmux solution for unlocked pins/peripherals. This ensures that minor changes to the automatic solver in a future
 * version of the tool will not impact the pinmux you originally saw.  These lines can be completely deleted in order to
 * re-solve from scratch.
 */
Board.peripheral.$suggestSolution          = "DEBUGSS";
Board.peripheral.swclkPin.$suggestSolution = "PA20";
Board.peripheral.swdioPin.$suggestSolution = "PA19";
I2C1.peripheral.$suggestSolution           = "I2C0";
I2C1.peripheral.sdaPin.$suggestSolution    = "PA0";
I2C1.peripheral.sclPin.$suggestSolution    = "PA1/NRST";
SYSCTL.peripheral.$suggestSolution         = "SYSCTL";
